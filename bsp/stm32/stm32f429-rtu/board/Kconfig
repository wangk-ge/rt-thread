## bsp/stm32/stm32f429-rtu/board/Kconfig
```kconfig
menu "Hardware Drivers Config"

config SOC_STM32F429VG
    bool
    select SOC_SERIES_STM32F4
    select RT_USING_COMPONENTS_INIT
    select RT_USING_USER_MAIN
    default y

menu "Onboard Peripheral Drivers"

    config BSP_USING_RS232
        bool "Enable RS232"
        select BSP_USING_UART
        select BSP_USING_UART1
        default y
        
    config BSP_USING_SPI_FLASH
        bool "Enable SPI FLASH (W25Q128 spi1)"
        select BSP_USING_SPI
        select BSP_USING_SPI1
        select RT_USING_SFUD
        select RT_SFUD_USING_SFDP
        default n
    
    # TB22 AT device configuration
    menuconfig AT_DEVICE_USING_TB22
        bool "CETC TB22"
        default n

    if AT_DEVICE_USING_TB22

        config AT_DEVICE_TB22_INIT_ASYN
            bool "Enable initialize by thread"
            default n

        config TB22_POWER_PIN
            int "Power pin"
            default -1

        config TB22_RESET_PIN
            int "Reset pin"
            default -1

        config TB22_DEVICE_NAME
            string "AT device name"
            default "tb22"
			
        config TB22_CLIENT_NAME
            string "AT client name"
            default "uart3"

        config TB22_RECV_BUFF_LEN
            int "The maximum length of receive line buffer"
            default 512

    endif
	
	config KAWAII_MQTT_USE_SAL
        bool "Enable SAL KAWAII_MQTT"
        default y
    
endmenu

menu "On-chip Peripheral Drivers"

    config BSP_USING_GPIO
        bool "Enable GPIO"
        select RT_USING_PIN
        default y

    menuconfig BSP_USING_UART
        bool "Enable UART"
        default y
        select RT_USING_SERIAL
        if BSP_USING_UART
            config BSP_USING_UART1
                bool "Enable UART1"
                default y

            config BSP_UART1_RX_USING_DMA
                bool "Enable UART1 RX DMA"
                depends on BSP_USING_UART1 && RT_SERIAL_USING_DMA
                default y
				
			config BSP_USING_UART2
                bool "Enable UART2"
                default y

			config BSP_UART2_TX_USING_DMA
                bool "Enable UART2 TX DMA"
                depends on BSP_USING_UART2 && RT_SERIAL_USING_DMA
                default y

            config BSP_USING_UART3
                bool "Enable UART3"
                default y

            config BSP_UART3_RX_USING_DMA
                bool "Enable UART3 RX DMA"
                depends on BSP_USING_UART3 && RT_SERIAL_USING_DMA
                default y
			
			config BSP_USING_UART4
                bool "Enable UART4"
                default n

            config BSP_UART4_RX_USING_DMA
                bool "Enable UART4 RX DMA"
                depends on BSP_USING_UART4 && RT_SERIAL_USING_DMA
                default n
                
            config BSP_USING_UART5
                bool "Enable UART5"
                default n

            config BSP_UART5_RX_USING_DMA
                bool "Enable UART5 RX DMA"
                depends on BSP_USING_UART5 && RT_SERIAL_USING_DMA
                default n
				
			config BSP_USING_UART6
                bool "Enable UART6"
                default y
			
			config BSP_UART6_TX_USING_DMA
                bool "Enable UART6 TX DMA"
                depends on BSP_USING_UART6 && RT_SERIAL_USING_DMA
                default y
				
			config BSP_USING_UART7
                bool "Enable UART7"
                default y
				
			config BSP_UART7_TX_USING_DMA
                bool "Enable UART7 TX DMA"
                depends on BSP_USING_UART7 && RT_SERIAL_USING_DMA
                default y
				
			config BSP_USING_UART8
                bool "Enable UART8"
                default y
				
			config BSP_UART8_TX_USING_DMA
                bool "Enable UART8 TX DMA"
                depends on BSP_USING_UART8 && RT_SERIAL_USING_DMA
                default y
        endif

    config BSP_USING_ON_CHIP_FLASH
        bool "Enable on-chip FLASH"
        default n

    menuconfig BSP_USING_SPI
        bool "Enable SPI BUS"
        default n
        select RT_USING_SPI
        if BSP_USING_SPI  
            config BSP_USING_SPI1
                bool "Enable SPI1 BUS"
                default n

            config BSP_SPI1_TX_USING_DMA
                bool "Enable SPI1 TX DMA"
                depends on BSP_USING_SPI1
                default n
                
            config BSP_SPI1_RX_USING_DMA
                bool "Enable SPI1 RX DMA"
                depends on BSP_USING_SPI1
                select BSP_SPI1_TX_USING_DMA
                default n  
        endif

    menuconfig BSP_USING_ONCHIP_RTC
        bool "Enable RTC"
        select RT_USING_RTC
        select RT_USING_LIBC
        default n
        if BSP_USING_ONCHIP_RTC
            choice
                prompt "Select clock source"
                default BSP_RTC_USING_LSE

                config BSP_RTC_USING_LSE
                    bool "RTC USING LSE"

                config BSP_RTC_USING_LSI
                    bool "RTC USING LSI"
            endchoice
        endif

    config BSP_USING_WDT
        bool "Enable Watchdog Timer"
        select RT_USING_WDT
        default n

    source "../libraries/HAL_Drivers/Kconfig"
    
endmenu

menu "Board extended module Drivers"

endmenu

endmenu
```
